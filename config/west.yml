## config/west.yml
```yaml
manifest:
  remotes:
    - name: zmkfirmware
      url-base: https://github.com/zmkfirmware
    - name: badjeff
      url-base: https://github.com/badjeff
    - name: Ziembski
      url-base: https://github.com/Ziembski
  projects:
    - name: zmk
      remote: zmkfirmware
      revision: v0.3
      import: app/west.yml
    - name: zmk-pmw3610-driver          # badjeff driver
      remote: badjeff
      revision: main
    - name: zmk-input-processor-volume  # custom volume processor module
      remote: Ziembski   
      revision: main
      path: zmk-input-processor-volume
    - name: peahen-calling              
      remote: Ziembski
      revision: main
      path: modules/peahen-calling

  self:
    path: config
```
